## firmware/main/Kconfig.projbuild
```kconfig
menu "Smart Visual Alarm"

config SVA_DEVICE_ID
    string "Device identifier"
    default "esp32s3-eye-01"
    help
        Identifier included in every MQTT event.

config SVA_WIFI_SSID
    string "Wi-Fi SSID"
    default ""
    help
        Leave empty to run detection without network publishing.

config SVA_WIFI_PASSWORD
    string "Wi-Fi password"
    default ""

config SVA_WIFI_MAX_RETRY
    int "Wi-Fi maximum reconnect attempts"
    range 1 30
    default 5

config SVA_WIFI_CONNECT_TIMEOUT_SECONDS
    int "Wi-Fi startup wait timeout"
    range 1 120
    default 15

config SVA_MQTT_URI
    string "MQTT broker URI"
    default "mqtt://192.168.1.100:1883"

config SVA_MQTT_TOPIC
    string "MQTT alert topic"
    default "smart-visual-alarm/events"

config SVA_MQTT_USERNAME
    string "MQTT username"
    default ""

config SVA_MQTT_PASSWORD
    string "MQTT password"
    default ""

config SVA_DETECTION_SCORE_THRESHOLD_PERCENT
    int "Person detection threshold percent"
    range 1 100
    default 70

config SVA_CONFIRMATION_FRAMES
    int "Consecutive detection frames required"
    range 1 20
    default 3

config SVA_ALERT_COOLDOWN_SECONDS
    int "Alert cooldown seconds"
    range 1 3600
    default 30

config SVA_DETECTION_FPS
    int "Detector frame rate cap"
    range 1 30
    default 5

config SVA_LCD_PREVIEW
    bool "Show camera preview on ESP32-S3-EYE LCD"
    default y
    help
        Draw the latest analyzed camera frame on the onboard LCD with a
        bounding box for the best person candidate.

config SVA_LCD_BOX_LINE_WIDTH
    int "LCD bounding box line width"
    depends on SVA_LCD_PREVIEW
    range 1 12
    default 3

endmenu
```

## firmware/sdkconfig.defaults
```kconfig
CONFIG_IDF_TARGET="esp32s3"
CONFIG_ESPTOOLPY_FLASHMODE_QIO=y
CONFIG_ESPTOOLPY_FLASHSIZE_8MB=y
CONFIG_PARTITION_TABLE_CUSTOM=y
CONFIG_PARTITION_TABLE_CUSTOM_FILENAME="partitions.csv"
CONFIG_PARTITION_TABLE_FILENAME="partitions.csv"
CONFIG_COMPILER_OPTIMIZATION_PERF=y
CONFIG_HTTPD_MAX_REQ_HDR_LEN=512
CONFIG_SPIRAM=y
CONFIG_SPIRAM_MODE_OCT=y
CONFIG_SPIRAM_XIP_FROM_PSRAM=y
CONFIG_SPIRAM_SPEED_80M=y
CONFIG_ESP_DEFAULT_CPU_FREQ_MHZ_240=y
CONFIG_ESP32S3_INSTRUCTION_CACHE_32KB=y
CONFIG_ESP32S3_DATA_CACHE_64KB=y
CONFIG_ESP32S3_DATA_CACHE_LINE_64B=y
CONFIG_ESP_SYSTEM_ALLOW_RTC_FAST_MEM_AS_HEAP=n
CONFIG_FATFS_LFN_HEAP=y
CONFIG_FREERTOS_HZ=1000
CONFIG_FREERTOS_VTASKLIST_INCLUDE_COREID=y
CONFIG_FREERTOS_GENERATE_RUN_TIME_STATS=y
CONFIG_FREERTOS_RUN_TIME_COUNTER_TYPE_U64=y
CONFIG_ESP_CONSOLE_USB_SERIAL_JTAG=y
CONFIG_ESP_CONSOLE_SECONDARY_NONE=y
CONFIG_CAMERA_PSRAM_DMA=y
CONFIG_BSP_SD_FORMAT_ON_MOUNT_FAIL=y

CONFIG_SVA_DEVICE_ID="esp32s3-eye-01"
CONFIG_SVA_WIFI_SSID=""
CONFIG_SVA_WIFI_PASSWORD=""
CONFIG_SVA_WIFI_MAX_RETRY=5
CONFIG_SVA_WIFI_CONNECT_TIMEOUT_SECONDS=15
CONFIG_SVA_MQTT_URI="mqtt://192.168.1.100:1883"
CONFIG_SVA_MQTT_TOPIC="smart-visual-alarm/events"
CONFIG_SVA_MQTT_USERNAME=""
CONFIG_SVA_MQTT_PASSWORD=""
CONFIG_SVA_DETECTION_SCORE_THRESHOLD_PERCENT=70
CONFIG_SVA_CONFIRMATION_FRAMES=2
CONFIG_SVA_ALERT_COOLDOWN_SECONDS=2
CONFIG_SVA_DETECTION_FPS=5
CONFIG_SVA_LCD_PREVIEW=y
CONFIG_SVA_LCD_BOX_LINE_WIDTH=3
```
